/*

  XBM.pde
  
  drawXBM example code.
  
  >>> Before compiling: Please remove comment from the constructor of the 
  >>> connected graphics display (see below).
  
  Universal 8bit Graphics Library, https://github.com/olikraus/u8glib/
  
  Copyright (c) 2012, olikraus@gmail.com
  All rights reserved.

  Redistribution and use in source and binary forms, with or without modification, 
  are permitted provided that the following conditions are met:

  * Redistributions of source code must retain the above copyright notice, this list 
    of conditions and the following disclaimer.
    
  * Redistributions in binary form must reproduce the above copyright notice, this 
    list of conditions and the following disclaimer in the documentation and/or other 
    materials provided with the distribution.

  THIS SOFTWARE IS PROVIDED BY THE COPYRIGHT HOLDERS AND 
  CONTRIBUTORS "AS IS" AND ANY EXPRESS OR IMPLIED WARRANTIES, 
  INCLUDING, BUT NOT LIMITED TO, THE IMPLIED WARRANTIES OF 
  MERCHANTABILITY AND FITNESS FOR A PARTICULAR PURPOSE ARE 
  DISCLAIMED. IN NO EVENT SHALL THE COPYRIGHT HOLDER OR 
  CONTRIBUTORS BE LIABLE FOR ANY DIRECT, INDIRECT, INCIDENTAL, 
  SPECIAL, EXEMPLARY, OR CONSEQUENTIAL DAMAGES (INCLUDING, BUT 
  NOT LIMITED TO, PROCUREMENT OF SUBSTITUTE GOODS OR SERVICES; 
  LOSS OF USE, DATA, OR PROFITS; OR BUSINESS INTERRUPTION) HOWEVER 
  CAUSED AND ON ANY THEORY OF LIABILITY, WHETHER IN CONTRACT, 
  STRICT LIABILITY, OR TORT (INCLUDING NEGLIGENCE OR OTHERWISE) 
  ARISING IN ANY WAY OUT OF THE USE OF THIS SOFTWARE, EVEN IF 
  ADVISED OF THE POSSIBILITY OF SUCH DAMAGE.  
  
*/
#include <DFRobot_Gesture.h>
#include <Wire.h>

#include "U8glib.h"

// setup u8g object, please remove comment from one of the following constructor calls
// IMPORTANT NOTE: The following list is incomplete. The complete list of supported 
// devices with all constructor calls is here: https://github.com/olikraus/u8glib/wiki/device

int testPin= 7;
unsigned char cmd;

DFRobot_Gesture myGesture;
U8GLIB_SSD1306_128X64 u8g(U8G_I2C_OPT_DEV_0|U8G_I2C_OPT_NO_ACK|U8G_I2C_OPT_FAST);	// Fast I2C / TWI 

#define u8g_logo_width 64
#define u8g_logo_height 64
//static unsigned char u8g_logo_bits[] = {
 static unsigned char face_eye_center[] U8G_PROGMEM = {
  0x00, 0x00, 0x00, 0xFF, 0xFF, 0x00, 0x00, 0x00, 0x00, 0x00, 0xC0, 0xFF, 
  0xFF, 0x03, 0x00, 0x00, 0x00, 0x00, 0xF0, 0x09, 0xE0, 0x1F, 0x00, 0x00, 
  0x00, 0x00, 0x7C, 0x00, 0x00, 0x7D, 0x00, 0x00, 0x00, 0x00, 0x1E, 0x00, 
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  0x00, 0x00, 0x00, 0xE0, 0xFF, 0x0F, 0x00, 0x00, };


static unsigned char face_eye_down[] U8G_PROGMEM = {
  0x00, 0x00, 0x00, 0xFF, 0xFF, 0x00, 0x00, 0x00, 0x00, 0x00, 0xC0, 0xFF, 
  0xFF, 0x03, 0x00, 0x00, 0x00, 0x00, 0xF0, 0x09, 0xE0, 0x1F, 0x00, 0x00, 
  0x00, 0x00, 0x7C, 0x00, 0x00, 0x7D, 0x00, 0x00, 0x00, 0x00, 0x1E, 0x00, 
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  0x00, 0x00, 0x00, 0xE0, 0xFF, 0x0F, 0x00, 0x00, };

  
static unsigned char face_eye_up[] U8G_PROGMEM = {
  0x00, 0x00, 0x00, 0xFF, 0xFF, 0x00, 0x00, 0x00, 0x00, 0x00, 0xC0, 0xFF, 
  0xFF, 0x03, 0x00, 0x00, 0x00, 0x00, 0xF0, 0x09, 0xE0, 0x1F, 0x00, 0x00, 
  0x00, 0x00, 0x7C, 0x00, 0x00, 0x7D, 0x00, 0x00, 0x00, 0x00, 0x1F, 0x00, 
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  0x00, 0x00, 0x00, 0xE0, 0xFF, 0x0F, 0x00, 0x00, };


static unsigned char face_eye_right[] U8G_PROGMEM = {
  0x00, 0x00, 0x00, 0xFF, 0xFF, 0x00, 0x00, 0x00, 0x00, 0x00, 0xC0, 0xFF, 
  0xFF, 0x03, 0x00, 0x00, 0x00, 0x00, 0xF0, 0x09, 0xE0, 0x1F, 0x00, 0x00, 
  0x00, 0x00, 0x7C, 0x00, 0x00, 0x7D, 0x00, 0x00, 0x00, 0x00, 0x1E, 0x00, 
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  0x00, 0x00, 0x00, 0xE0, 0xFF, 0x0F, 0x00, 0x00, };

static unsigned char face_eye_left[] U8G_PROGMEM = {
  0x00, 0x00, 0x00, 0xFF, 0xFF, 0x00, 0x00, 0x00, 0x00, 0x00, 0xC0, 0xFF, 
  0xFF, 0x03, 0x00, 0x00, 0x00, 0x00, 0xF0, 0x09, 0xE0, 0x1F, 0x00, 0x00, 
  0x00, 0x00, 0x7C, 0x00, 0x00, 0x7D, 0x00, 0x00, 0x00, 0x00, 0x1E, 0x00, 
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  0x00, 0x00, 0x00, 0xE0, 0xFF, 0x0F, 0x00, 0x00, };


  
void draw_face_eye_down(void) {
  // graphic commands to redraw the complete screen should be placed here  
  u8g.drawXBMP( 5, 0, u8g_logo_width, u8g_logo_height, face_eye_down);
}

void draw_face_eye_up(void) {
  // graphic commands to redraw the complete screen should be placed here  
  u8g.drawXBMP( 5, 0, u8g_logo_width, u8g_logo_height, face_eye_up);
}

void draw_face_eye_right(void) {
  // graphic commands to redraw the complete screen should be placed here  
  u8g.drawXBMP( 5, 0, u8g_logo_width, u8g_logo_height, face_eye_right);
}

void draw_face_eye_left(void) {
  // graphic commands to redraw the complete screen should be placed here  
  u8g.drawXBMP( 5, 0, u8g_logo_width, u8g_logo_height, face_eye_left);
}

void draw_face_eye_center(void) {
  // graphic commands to redraw the complete screen should be placed here  
  u8g.drawXBMP( 5, 0, u8g_logo_width, u8g_logo_height, face_eye_center);
}




void setup(void) {
  // flip screen, if required
  u8g.setRot90();
  
  Wire.begin();
  Serial.begin(9600);
  pinMode(testPin, INPUT);
  u8g.firstPage();  
  do {
    draw_face_eye_center();
  } while( u8g.nextPage() );
}

void loop(void) {
  myGesture.I2C1_MasterRead(md.buf,26,0x42); //The address is:0x42
  cmd = myGesture.mgcProcMsg();     //process the message
  if(cmd != GI_NOGESTURE )
            {
                switch(cmd)
                {
                 
                    case GI_FLICK_R:
                      Serial.println("RIGHT");
                      u8g.firstPage();  
                      do {
                       draw_face_eye_right();
                      } while( u8g.nextPage() );
                        break;

                    case GI_FLICK_L:
                        Serial.println("LEFT");
                        u8g.firstPage();  
                      do {
                       draw_face_eye_left();
                      } while( u8g.nextPage() );
                        break;
                     
                    case GI_FLICK_D:
                     Serial.println("DOWN");
                     u8g.firstPage();  
                      do {
                       draw_face_eye_down();
                      } while( u8g.nextPage() );
                        break;

                    case GI_FLICK_U:
                       Serial.println("UP");
                        u8g.firstPage();  
                      do {
                       draw_face_eye_up();
                      } while( u8g.nextPage() );
                        break;
                    case GI_AIRWHEEL_CW://Clockwise in circles
                     Serial.println("CW");
                     u8g.firstPage();  
                      do {
                       draw_face_eye_left();
                      } while( u8g.nextPage() );
                      delay(200);
                      u8g.firstPage();  
                      do {
                       draw_face_eye_up();
                      } while( u8g.nextPage() );
                      delay(200);
                      u8g.firstPage();  
                      do {
                       draw_face_eye_right();
                      } while( u8g.nextPage() );
                      delay(200);
                      u8g.firstPage();  
                      do {
                       draw_face_eye_down();
                      } while( u8g.nextPage() );
                        break;

                    case GI_AIRWHEEL_CCW://Counterclockwise circles
                       Serial.println("CCW");
                       u8g.firstPage();  
                      do {
                       draw_face_eye_left();
                      } while( u8g.nextPage() );
                      delay(200);
                      u8g.firstPage();  
                      do {
                       draw_face_eye_down();
                      } while( u8g.nextPage() );
                      delay(200);
                      u8g.firstPage();  
                      do {
                       draw_face_eye_right();
                      } while( u8g.nextPage() );
                      delay(200);
                      u8g.firstPage();  
                      do {
                       draw_face_eye_up();
                      } while( u8g.nextPage() );
                        break;

                    default:
                        u8g.firstPage();  
                        do {
                            draw_face_eye_center();
                          } while( u8g.nextPage() );   
                          break;
                }
            }
  }
  
// else  {};
  
  
  
  /* picture loop
  
  u8g.firstPage();  
  do {
    draw_face_eye_center();
  } while( u8g.nextPage() );
  
  // rebuild the picture after some delay
  delay(200);
  
 
  */

